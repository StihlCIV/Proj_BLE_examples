## broadcaster_multiple/boards/arm/bc2_prototype_rev02/Kconfig.board
```kconfig
# Copyright (c) 2023 Nordic Semiconductor ASA
# SPDX-License-Identifier: Apache-2.0

config BOARD_BC2_PROTOTYPE_REV02
	bool "BC2_Prototype_Rev02"
	depends on SOC_NRF52840_QIAA
```

## broadcaster_multiple/boards/arm/bc2_prototype_rev02/Kconfig.defconfig
```kconfig
# Copyright (c) 2023 Nordic Semiconductor ASA
# SPDX-License-Identifier: Apache-2.0

if BOARD_BC2_PROTOTYPE_REV02

config BOARD
	default "bc2_prototype_rev02"

config BT_CTLR
   default BT

endif
```

## broadcaster_multiple/build_BC2_Prototype/Kconfig/Kconfig.shield
```kconfig
osource "/Users/cvs_macbook4/VS_Projects/Proj_Github/BC2_Prototype/boards/shields/*/Kconfig.shield"
osource "/Users/cvs_macbook4/VS_Projects/Proj_nordic_ble/broadcaster_multiple/boards/shields/*/Kconfig.shield"
osource "/opt/nordic/ncs/v2.4.0/nrf/boards/shields/*/Kconfig.shield"
```

## bt-fund/lesson5/blefund_less5_exer2_solution/build_1/Kconfig/Kconfig.shield.defconfig
```kconfig
osource "/Users/cvs_macbook4/Documents/Proj_nordic_ble/bt-fund/lesson5/blefund_less5_exer2_solution/boards/shields/*/Kconfig.defconfig"
osource "/opt/nordic/ncs/v2.4.0/nrf/boards/shields/*/Kconfig.defconfig"
```
